/*--------------------------------------------
	Written by:	林震
	Modify by: 	林震
    Date:       2011.04.09
    Update:     2011.06.06
	说明：LCD显示初始化及相关函数调用
----------------------------------------------*/        
uint LCD_flag,LCD_para_num=40;  //LCD页标记位,小车参数标记位
int LCD_para_sdj,LCD_para_xdj;  //上舵机值,下舵机值

#define RST PTM_PTM7      		//复位用M7口   
#define SCE PTM_PTM6          //片选用M6口
#define DC PTM_PTM5           //DC用M5口
#define SDIN PTM_PTM4         //数据用M4口
#define SCLK PTM_PTM3       	//时钟用M3口
#define KEY3 PTM_PTM0         //按钮3
#define KEY2 PTM_PTM1         //按钮2
#define KEY1 PTM_PTM2         //按钮1
unsigned char lcdx=0,lcdy=0;
/*
sbit    \SCE = SCE;  //片选		
sbit    \RST = RST;  //复位,0复位
sbit    D/C  = DC;  //1写数据，0写指令
sbit    SDIN = SDIN;  //数据
sbit    SCLK = SCLK;  //时钟
*/

/*--------------------------------------------
data: 5*8字符
说明：根据ASCII码排列，字模数据是由空格(sp)开始,空格字符的ASCII的值就是32  
编写日期：20110409 
----------------------------------------------*/
unsigned char data[]={
0x00, 0x00, 0x00, 0x00, 0x00,   // sp     
0x00, 0x00, 0x2f, 0x00, 0x00,   // !     
0x00, 0x07, 0x00, 0x07, 0x00,   // "     
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0x08, 0x10, 0x08, 0x04, 0x08   // ~    
};

/*--------------------------------------------
hanzi: 自定义汉字字库
说明：如需添加汉字，在最后面按顺序添加，切勿中间插入
编写日期：20110409 
----------------------------------------------*/
unsigned char hanzi[]=
{
/*--  文字:  厦  --*/
/*--  宋体12;  此字体下对应的点阵为：宽x高=16x16   --*/
0x00,0x00,0xFF,0x05,0x05,0xF5,0x55,0x5D,0x55,0x55,0x55,0x55,0xF5,0x05,0x01,0x00,
0x40,0x30,0x0F,0x80,0xA0,0x97,0xBD,0x55,0x55,0x55,0x55,0x55,0xB7,0x80,0x80,0x00,

/*--  文字:  门  --*/
/*--  宋体12;  此字体下对应的点阵为：宽x高=16x16   --*/
0x00,0xF8,0x01,0x06,0x00,0x00,0x02,0x02,0x02,0x02,0x02,0x02,0x02,0xFE,0x00,0x00,
0x00,0xFF,0x00,0x00,0x00,0x00,0x00,0x00,0x00,0x00,0x00,0x40,0x80,0x7F,0x00,0x00,

/*--  文字:  大  --*/
/*--  宋体12;  此字体下对应的点阵为：宽x高=16x16   --*/
0x20,0x20,0x20,0x20,0x20,0x20,0x20,0xFF,0x20,0x20,0x20,0x20,0x20,0x20,0x20,0x00,
0x80,0x80,0x40,0x20,0x10,0x0C,0x03,0x00,0x03,0x0C,0x10,0x20,0x40,0x80,0x80,0x00,

/*--  文字:  学  --*/
/*--  宋体12;  此字体下对应的点阵为：宽x高=16x16   --*/
0x40,0x30,0x11,0x96,0x90,0x90,0x91,0x96,0x90,0x90,0x98,0x14,0x13,0x50,0x30,0x00,
0x04,0x04,0x04,0x04,0x04,0x44,0x84,0x7E,0x06,0x05,0x04,0x04,0x04,0x04,0x04,0x00,

/*--  文字:  嘉  --*/
/*--  宋体12;  此字体下对应的点阵为：宽x高=16x16   --*/
0x02,0x02,0x0A,0xEA,0xAA,0xAA,0xAA,0xAF,0xAA,0xAA,0xAA,0xEA,0x0A,0x02,0x02,0x00,
0x82,0x4A,0x2A,0x1E,0x0B,0x4A,0x8A,0x7A,0x02,0xFA,0x4B,0x4A,0x4A,0xFA,0x02,0x00,

/*--  文字:  庚 --*/
/*--  宋体12;  此字体下对应的点阵为：宽x高=16x16   --*/
0x00,0x00,0xFC,0x04,0x24,0x24,0x24,0x25,0xF6,0x24,0x24,0x24,0xE4,0x04,0x04,0x00,
0x40,0x30,0x8F,0x81,0x49,0x49,0x29,0x19,0x0F,0x19,0x29,0x49,0x4F,0x81,0x81,0x00,

/*--  文字:  学  --*/
/*--  宋体12;  此字体下对应的点阵为：宽x高=16x16   --*/
0x40,0x30,0x10,0x12,0x5C,0x54,0x50,0x51,0x5E,0xD4,0x50,0x18,0x57,0x32,0x10,0x00,
0x00,0x02,0x02,0x02,0x02,0x02,0x42,0x82,0x7F,0x02,0x02,0x02,0x02,0x02,0x02,0x00,

/*--  文字:  院  --*/
/*--  宋体12;  此字体下对应的点阵为：宽x高=16x16   --*/
0xFE,0x02,0x32,0x4A,0x86,0x0C,0x24,0x24,0x25,0x26,0x24,0x24,0x24,0x0C,0x04,0x00,
0xFF,0x00,0x02,0x04,0x83,0x41,0x31,0x0F,0x01,0x01,0x7F,0x81,0x81,0x81,0xF1,0x00,

/*--  文字:  光  --*/
/*--  宋体12;  此字体下对应的点阵为：宽x高=16x16   --*/
0x40,0x40,0x42,0x44,0x58,0xC0,0x40,0x7F,0x40,0xC0,0x50,0x48,0x46,0x40,0x40,0x00,
0x80,0x80,0x40,0x20,0x18,0x07,0x00,0x00,0x00,0x3F,0x40,0x40,0x40,0x40,0x78,0x00,

/*--  文字:  电  --*/
/*--  宋体12;  此字体下对应的点阵为：宽x高=16x16   --*/
0x00,0x00,0xF8,0x88,0x88,0x88,0x88,0xFF,0x88,0x88,0x88,0x88,0xF8,0x00,0x00,0x00,
0x00,0x00,0x1F,0x08,0x08,0x08,0x08,0x7F,0x88,0x88,0x88,0x88,0x9F,0x80,0xF0,0x00,

/*--  文字:  谷  --*/
/*--  宋体12;  此字体下对应的点阵为：宽x高=16x16   --*/
0x00,0x10,0x88,0x84,0x43,0x20,0x10,0x0C,0x10,0x20,0x41,0x82,0x84,0x08,0x00,0x00,
0x01,0x01,0x00,0xFE,0x42,0x42,0x42,0x42,0x42,0x42,0x42,0xFE,0x00,0x01,0x01,0x00,

/*--  文字:  风  --*/
/*--  宋体12;  此字体下对应的点阵为：宽x高=16x16   --*/
0x00,0x00,0xFE,0x02,0x12,0x22,0xC2,0x02,0xC2,0x32,0x02,0xFE,0x00,0x00,0x00,0x00,
0x80,0x60,0x1F,0x00,0x20,0x10,0x0C,0x03,0x0C,0x30,0x00,0x0F,0x30,0x40,0xF8,0x00,

/*--  文字:  小  --*/
/*--  宋体12;  此字体下对应的点阵为：宽x高=16x16   --*/
0x00,0x00,0x00,0xE0,0x00,0x00,0x00,0xFF,0x00,0x00,0x00,0x20,0x40,0x80,0x00,0x00,
0x08,0x04,0x03,0x00,0x00,0x40,0x80,0x7F,0x00,0x00,0x00,0x00,0x00,0x01,0x0E,0x00,
/*--  文字:  车  --*/
/*--  宋体12;  此字体下对应的点阵为：宽x高=16x16   --*/
0x00,0x08,0x88,0x48,0x28,0x18,0x0F,0xE8,0x08,0x08,0x08,0x08,0x08,0x08,0x00,0x00,
0x08,0x08,0x09,0x09,0x09,0x09,0x09,0xFF,0x09,0x09,0x09,0x09,0x09,0x08,0x08,0x00,
/*--  文字:  状  --*/
/*--  宋体12;  此字体下对应的点阵为：宽x高=16x16   --*/
0x00,0x08,0x30,0x00,0xFF,0x20,0x20,0x20,0x20,0xFF,0x20,0x20,0x22,0x2C,0x20,0x00,
0x04,0x04,0x02,0x01,0xFF,0x80,0x40,0x30,0x0E,0x01,0x06,0x18,0x20,0x40,0x80,0x00,
/*--  文字:  态  --*/
/*--  宋体12;  此字体下对应的点阵为：宽x高=16x16   --*/
0x00,0x04,0x84,0x84,0x44,0x24,0x54,0x8F,0x14,0x24,0x44,0x84,0x84,0x04,0x00,0x00,
0x41,0x39,0x00,0x00,0x3C,0x40,0x40,0x42,0x4C,0x40,0x40,0x70,0x04,0x09,0x31,0x00,
/*--  文字:  修  --*/
/*--  宋体12;  此字体下对应的点阵为：宽x高=16x16   --*/
0x40,0x20,0xF8,0x07,0xF0,0xA0,0x90,0x4C,0x57,0x24,0xA4,0x54,0x4C,0x80,0x80,0x00,
0x00,0x00,0xFF,0x00,0x1F,0x80,0x92,0x52,0x49,0x29,0x24,0x12,0x08,0x00,0x00,0x00,
/*--  文字:  改  --*/
/*--  宋体12;  此字体下对应的点阵为：宽x高=16x16   --*/
0x04,0x84,0x84,0x84,0x84,0xFC,0x40,0x30,0xCC,0x0B,0x08,0x08,0xF8,0x08,0x08,0x00,
0x00,0x7F,0x20,0x10,0x10,0x08,0x80,0x40,0x21,0x16,0x08,0x16,0x21,0x40,0x80,0x00,
/*--  文字:  参  --*/
/*--  宋体12;  此字体下对应的点阵为：宽x高=16x16   --*/
0x00,0x20,0x20,0xA8,0x6C,0x2A,0x39,0x28,0xA8,0x2A,0x6C,0xA8,0x20,0x20,0x00,0x00,
0x02,0x82,0x81,0x90,0x92,0x4A,0x49,0x45,0x24,0x22,0x10,0x08,0x01,0x02,0x02,0x00,
/*--  文字:  数  --*/
/*--  宋体12;  此字体下对应的点阵为：宽x高=16x16   --*/
0x90,0x52,0x34,0x10,0xFF,0x10,0x34,0x52,0x80,0x70,0x8F,0x08,0x08,0xF8,0x08,0x00,
0x82,0x9A,0x56,0x63,0x22,0x52,0x8E,0x00,0x80,0x40,0x33,0x0C,0x33,0x40,0x80,0x00,
	
};


void delay_1ms(void)                  //1ms延时函数
{
	unsigned int i;
	for (i=0;i<600;i++)	  ;
;
}
void delay_nms(unsigned int n)        //N ms延时函数
  {
   unsigned int i=0;
   for (i=0;i<n;i++)
   delay_1ms();
  }

/*--------------------------------------------
LCD_write_byte: 使用SPI接口写数据到LCD
输入参数：dt：写入的数据；
command ：写数据/命令选择；
编写日期：20080918 
----------------------------------------------*/
void LCD_write_byte(unsigned char dt, unsigned char command)
{
	unsigned char i; 
	SCE=0;	
	DC=command;	
	for(i=0;i<8;i++)
	{ 
		if(dt&0x80)
			SDIN=1;
		else
			SDIN=0;
		dt=dt<<1;		
		SCLK=0; 		
		SCLK=1; 
	}	
	DC=1;	
	SCE=1;	
	SDIN=1;
}
/*-------------------------------------------
LCD_set_XY: 设置LCD坐标函数
输入参数：X：0－83  Y：0－5
编写日期：20080918 
---------------------------------------------*/
void LCD_set_XY(unsigned char X, unsigned char Y)
{
	LCD_write_byte(0x40 | Y, 0);// column
	LCD_write_byte(0x80 | X, 0);// row
} 

/*------------------------------------------
LCD_clear: LCD清屏函数
编写日期：20080918 
--------------------------------------------*/
void LCD_clear(void)
{
	unsigned char t;
	unsigned char k;
	LCD_set_XY(0,0);
	for(t=0;t<6;t++)
	{ 
		for(k=0;k<84;k++)
		{ 
			LCD_write_byte(0x00,1);
				
		} 
	}
	lcdx=0,lcdy=0;
}

/*---------------------------------------------
LCD_position: 显示LCD字符当前位置
说明：判断当前位置并返回到lcdx和lcdy这两个全局变量，lcdx是行，lcdy是列
编写日期：20110410
-----------------------------------------------*/
void LCD_position(unsigned char row, unsigned char line)
 {

  int i;
  row++;
  i=row;
  if(i%13==0&&i!=0)
 {
  line++;
  row=0; 
 }
 lcdx=line;
 lcdy=row;
}
/*---------------------------------------------
LCD_write_zi: 显示5（宽）*8（高）点阵列数字字母符号等半角类
输入参数：c：显示的字符；
编写日期：20110409 
-----------------------------------------------*/
void LCD_write_zi(unsigned char row, unsigned char line,unsigned char c) //row:列 line:行 dd:字符
{
unsigned char i=0;     
unsigned int No;     
No=c-32;                 //字模数据是由空格开始,空格字符的ASCII的值就是32  
No*=5;  
	LCD_set_XY(row, line);// 列，行
while(i<5)                     //一个字符的字模是5个字节,就是5*8点阵     
  {     
    LCD_write_byte(data[No],1);       
    i++;     
   No++;
  } 
}
/*---------------------------------------------
LCD_write_cizu: 显示5（宽）*8（高）点阵列数字字母符号等半角类字符串
输入参数：c：显示的字符串
编写日期：20110410
-----------------------------------------------*/
 void LCD_write_cizu(unsigned char row, unsigned char line,char a[]) //row:列 line:行 dd:字符 
 {
 int i;
 row=row-6;
 for(i=0;i<strlen(a);i++) {
 if(i%13==0&&i!=0)
 {
  line++;
  row=-6; 
 }
 LCD_write_zi( row+=6,line,a[i]);
 }
 LCD_position(row,line);
 }
 
/*---------------------------------------------
LCD_write_shuzi: 显示5（宽）*8（高）点阵列数字
输入参数：a：显示的数字
编写日期：20110410
-----------------------------------------------*/
 void LCD_write_shuzi(unsigned char row, unsigned char line,int a) //row:列 line:行 dd:字符 
 {
 char b[10];
 (void)sprintf(b,"%d",a);
 LCD_write_cizu(row,line,b);

 }
 
/*---------------------------------------------
LCD_write_hanzi: 显示16（宽）*16（高）点阵列汉字等半角类
输入参数：c：显示的字符；
编写日期：20080918 
-----------------------------------------------*/
void LCD_write_hanzi(unsigned char row, unsigned char line,unsigned char c) //row:列 line:行 dd:字符
{
	unsigned char i;  	
	
	LCD_set_XY(row*4, line);// 列，行 
	for(i=0; i<16;i++) 
	{
		LCD_write_byte(hanzi[c*32+i],1); 
	}
	
    LCD_set_XY(row*4, line+1);// 列，行 
	for(i=16; i<32;i++) 
	{
		LCD_write_byte(hanzi[c*32+i],1);
	}	
}

/*---------------------------------------
LCD_init: 5110LCD初始化
编写日期：20080918 
-----------------------------------------  */
void LCD_init(void)
{
  DDRM = 0XF8;        //初始化M7~M3口
	RST=0;  	
  delay_1ms();
  RST=1;  
	LCD_write_byte(0x21,0);//初始化Lcd,功能设定使用扩充指令
	LCD_write_byte(0xd0,0);//设定液晶偏置电压
	LCD_write_byte(0x20,0);//使用基本指令
	LCD_write_byte(0x0C,0);//设定显示模式，正常显示
	LCD_clear(); //清屏幕
}
/*---------------------------------------
激光状态LCD显示
编写日期：200110604
-----------------------------------------  */ 
void LCD_jiguang(byte temp_laser_array[]) {
    uchar i; 
    byte LCD_temp_data;
    LCD_write_cizu(15,0,"JG-status");
    for(i=0;i<LASER_MAX;i++)    //发送激光管信息数组
        {LCD_temp_data=temp_laser_array[i];
            if(LCD_temp_data == 0){ 
      LCD_write_zi(i*7,1,'0');
            }
       else if(LCD_temp_data == 1){
      LCD_write_zi(i*7,1,'1');  
            }
        }   
} 

/*---------------------------------------
红外状态LCD显示
编写日期：200110604
-----------------------------------------  */
void LCD_hongwai(int temp_laser_array[]) {
    uchar i=0;
    char LCD_temp_red[4];
    LCD_write_cizu(15,3,"HW-status");
    do{  
      (void)sprintf(LCD_temp_red,"%.3d",temp_laser_array[i]);      
      if(i <= 3) {
       LCD_write_cizu(i*21,4,LCD_temp_red); 
                  }
       else       {
       LCD_write_cizu((i-3)*21-9,5,LCD_temp_red);
                  }
    i++;
    }while(i<7);   
} 

/*---------------------------------------------
LCD_start: 显示屏启动时显示"厦门大学嘉庚学院光电一队"
编写日期：20110409
-----------------------------------------------*/
void LCD_start(void) 
{
	LCD_clear();
	LCD_write_hanzi(0,0,0);   //厦
	LCD_write_hanzi(5,0,1);   //门
	LCD_write_hanzi(10,0,2);  //大
	LCD_write_hanzi(15,0,3);  //学
	
	LCD_write_hanzi(0,2,4);   //嘉
	LCD_write_hanzi(5,2,5);   //庚
	LCD_write_hanzi(10,2,6);  //学
	LCD_write_hanzi(15,2,7);  //院
	
	LCD_write_hanzi(0,4,8);   //光
	LCD_write_hanzi(5,4,9);   //电
	LCD_write_hanzi(10,4,10); //谷
	LCD_write_hanzi(15,4,11); //风
	}
/*---------------------------------------------
LCD_show: 显示屏显示主界面
编写日期：20110604
-----------------------------------------------*/
	void LCD_show(void) {
	LCD_clear();
	LCD_write_hanzi(0,0,12);   //小
	LCD_write_hanzi(5,0,13);   //车
	LCD_write_hanzi(10,0,14);  //状
	LCD_write_hanzi(15,0,15);  //态
	
	LCD_write_hanzi(0,2,16);   //修
	LCD_write_hanzi(5,2,17);   //改
	LCD_write_hanzi(10,2,18);  //参
	LCD_write_hanzi(15,2,19);  //数
	}
	/*---------------------------------------------
LCD_para: 显示屏显示修改参数的页面
编写日期：20110604
-----------------------------------------------*/
		void LCD_para(void) {
			LCD_clear();
		if(LCD_para_num-40>0)LCD_write_zi(0,LCD_para_num-41,'*');
    LCD_write_cizu(9,0,"SDJ");
    LCD_write_shuzi(40,0,LCD_para_sdj);
    LCD_write_cizu(9,1,"XDJ");
    LCD_write_shuzi(40,1,LCD_para_xdj);
		}
	 
/*---------------------------------------------
LCD_status: 显示屏显示小车状态的页面
编写日期：20110604
-----------------------------------------------*/
	void LCD_status(int a) {
	LCD_clear();
	     if(a==1)
	{ 
	LCD_jiguang(light_temp_laser_array);
	LCD_hongwai(IR_temp_laser_array); 
	} 
	else if(a==2)
	{
  LCD_para();
	}
	}
/*---------------------------------------------
LCD_para_modify: 修改参数的页面
参数：name是要改的参数编号,a是要改的值
编写日期：20110606
-----------------------------------------------*/
  void LCD_para_modify(uint name,int a) {
	LCD_clear();
	switch(name)
    {
    case 41:     //改变上舵机的值,41是上舵机的参数编号
  	LCD_write_cizu(13,1,"Modify SDJ"); 
    LCD_para_sdj=LCD_para_sdj+a;
    LCD_write_shuzi(27,3,LCD_para_sdj);
    break;
    case 42:     //改变下舵机的值,42是上舵机的参数编号
  	LCD_write_cizu(13,1,"Modify XDJ"); 
  	LCD_para_xdj=LCD_para_xdj+a;
    LCD_write_shuzi(27,3,LCD_para_xdj);
    break;
    } 
	}
/*---------------------------------------------
LCD_determine: 按键判断并执行动作
编写日期：20110606
-----------------------------------------------*/	
void LCD_determine(void) {
	/*  主页面按键设置  */
	uint result;
	int temp=0;
      if(KEY1==0&&LCD_flag==0)LCD_flag=11;                	/*进入小车状态页面1*/
else if(KEY2==0&&LCD_flag==0){LCD_flag=2;LCD_para_num=40;}	/*进入修改参数页面*/
else if(KEY3==0&&LCD_flag==0)LCD_flag=3;                  	/*进入第三个页面*/
	/*  小车状态页面1按键设置  */
else if(KEY1==0&&LCD_flag==11)LCD_flag=11;                	/*进入小车状态页面1*/
else if(KEY2==0&&LCD_flag==11)LCD_flag=12;                	/*进入小车状态页面2*/
else if(KEY3==0&&LCD_flag==11)LCD_flag=0;                		/*返回主页面*/
	/*  小车状态页面2按键设置  */
else if(KEY1==0&&LCD_flag==12)LCD_flag=11;                	/*进入小车状态页面1*/
else if(KEY2==0&&LCD_flag==12)LCD_flag=12;                	/*进入小车状态页面2*/
else if(KEY3==0&&LCD_flag==12)LCD_flag=0;                	  /*返回主页面*/	
	/*  修改参数页面按键设置  */
else if(KEY1==0&&LCD_flag==2)LCD_flag=LCD_para_num;
else if(KEY2==0&&LCD_flag==2){LCD_para_num+=1;delay_nms(400);}/*暂未写，功能选择下个值*/
else if(KEY3==0&&LCD_flag==2)LCD_flag=0;	
	/*  修改参数页面按键设置  */
else if(KEY1==0&&39<LCD_flag&&LCD_flag<50)temp=1;   /*暂未写，参数值变大*/
else if(KEY2==0&&39<LCD_flag&&LCD_flag<50)temp=-1;   /*暂未写，参数值变小*/
else if(KEY3==0&&39<LCD_flag&&LCD_flag<50){LCD_flag=2;LCD_para_num=40;}	/*返回参数主页面*/
	/*  第三个页面按键设置，三个按键暂时都是返回主页面  */
else if(KEY1==0&&LCD_flag==3)LCD_flag=0;
else if(KEY2==0&&LCD_flag==3)LCD_flag=0;
else if(KEY3==0&&LCD_flag==3)LCD_flag=0;
   result= LCD_flag;
    switch(result)
    {
    case 0:   	/*进入小车主页面*/
    LCD_show();							
  	delay_nms(400);
    break;
    case 11:   /*进入小车状态页面1*/
    LCD_status(1);								
  	delay_nms(400);
    break;
    case 12:  /*进入小车状态页面2*/
    LCD_status(2);						
  	delay_nms(400);
    break;
    case 2:   /*进入修改参数页面*/
    LCD_para();						
  	delay_nms(400);
    break;
    case 3:   /*进入第三个页面*/
    LCD_start();							
  	delay_nms(400);
    break;
    case 41:  //改变上舵机的值,41是上舵机的参数编号,详见 LCD_para_modify参数
    LCD_para_modify(41,temp);
    temp=0;						
  	delay_nms(400);
    break;
    case 42:  //改变下舵机的值,42是上舵机的参数编号,详见 LCD_para_modify参数
    LCD_para_modify(42,temp);	
    temp=0;					
  	delay_nms(400);
    break;
    }
}